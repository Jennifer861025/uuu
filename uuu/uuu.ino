#include<Wire.h>
#include<SPI.h>
#include<Adafruit_GFX.h>
#include<Adafruit_SSD_1306.h>
#include <LWiFi.h>

#define OLED_MOSI 11
#define OLED_CLK 12
#define OLED_DC 9
#define OLED_CS 8
#define OLED_RESET 10
Adafruit_SSD1306 display(OLED_MOSI,OLED_CLK,OLED_DC,OLED_RESET,OLED_CS);

char ssid[] = "Jennifer iphone";      //  your network SSID (name)
char pass[] = "aaaa4444";  // your network password (use for WPA, or use as key for WEP)
int keyIndex = 0;               // your network key Index number (needed only for WEP)

String apiKey = "IY1PP74Q593WDMPO";//Channel Write API Key 

const char* server = "api.thingspeak.com";

int status = WL_IDLE_STATUS;

WiFiClient client;
static const unsigned char PROGMEM Logo[] = {
 B11111111, B11111111, B11111111, B11111111, B11111111, B11111111, B11111111, B11111111, 
 B11111111, B11111111, B11111111, B11111111, B11111111, B11111111, B11111111, B11111111, 
  B11111111, B00000011, B11111111, B11111111, B11111111, B11111111, B11000000, B11111111, 
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  B11111111, B11111111, B11111111, B11111111, B11111111, B11111111, B11111111, B11111111, 
  
};
static const unsigned char PROGMEM LOGO1[] = {
 B11111111, B11111111, B11111111, B11111111, B11111111, B11111111, B11111111, B11111111, 
 B11111111, B11111111, B11111111, B11111111, B11111000, B00000011, B11111111, B11111111, 
  B11111111, B11111111, B11111111, B11111111, B11111000, B00000000, B11111111, B11111111, 
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  B11111111, B11111111, B11111111, B11111111, B11111111, B11111111, B11111111, B11111111, 
  
};


const int ledCount = 8;    // the number of LEDs in the bar graph
int ledPins[] = {1, 2, 3, 4, 5, 6, 7,13};  
#define fsr_pin A0
void printWifiStatus() {
    // print the SSID of the network you're attached to:
    Serial.print("SSID: ");
    Serial.println(WiFi.SSID());

    // print your WiFi shield's IP address:
    IPAddress ip = WiFi.localIP();
    Serial.print("IP Address: ");
    Serial.println(ip);

    // print the received signal strength:
    long rssi = WiFi.RSSI();
    Serial.print("signal strength (RSSI):");
    Serial.print(rssi);
    Serial.println(" dBm");
}

void setup() {
  // put your setup code here, to run once:
  Serial.begin(9600);
  display.begin(SSD1306_SWITCHCAPVCC);
  display.clearDisplay();
  display.drawBitmap(23,0,Logo,64,32,WHITE);
  display.display();
  Serial.begin(115200);
for (int thisLed = 0; thisLed < ledCount; thisLed++) {
pinMode(ledPins[thisLed], OUTPUT);
    }
     //Initialize serial and wait for port to open:
    Serial.begin(9600);
    while (!Serial) {
        ; // wait for serial port to connect. Needed for native USB port only
    }

    // attempt to connect to Wifi network:
    while (status != WL_CONNECTED) {
        Serial.print("Attempting to connect to SSID: ");
        Serial.println(ssid);
        // Connect to WPA/WPA2 network. Change this line if using open or WEP network:
        status = WiFi.begin(ssid, pass);
    }
    Serial.println("Connected to wifi");
    printWifiStatus();

}

void loop()
{
  int fsr_value = analogRead(fsr_pin); // 讀取FSR
  int led_value = map(fsr_value, 0, 1000, 0, 10); // 從0~1023映射到0~10

for (int thisLed = 0; thisLed < ledCount; thisLed++) {
  if (thisLed < led_value) {
   digitalWrite(ledPins[thisLed], HIGH);
  display.clearDisplay();
  display.drawBitmap(23,0,Logo,64,32,WHITE);
  display.display();

    }
 else {
      digitalWrite(ledPins[thisLed], LOW);
       display.clearDisplay();
  display.drawBitmap(23,0,LOGO1,64,32,WHITE);
  display.display();
    } 
        float h = fsr_value;
        String temp_data = "&field1=";
        temp_data += h;
    // if there are incoming bytes available
    // from the server, read them and print them:
          Serial.println("\nStarting connection to server...");

          if (client.connect(server, 80)) {
            client.print("GET https://api.thingspeak.com/update?api_key=");
            client.println(apiKey+temp_data);
            delay(10);
          }

        client.stop();
        delay(5000);
  }



  
}
